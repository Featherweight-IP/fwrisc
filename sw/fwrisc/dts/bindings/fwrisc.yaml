## sw/fwrisc/dts/bindings/fwrisc.yaml
```yaml
description: Featherweight IP RISC-V processor

compatible: "fwrisc"

include: [base.yaml]

properties:
    "#address-cells":
        const: 1
        
    "#size-cells":
        const: 0
```

## zephyr/boards/riscv/fwrisc_test/Kconfig.board
```kconfig
config BOARD_FWRISC_TEST
	bool "fwrisc_test SoC"
	depends on SOC_FWRISC_TESTSOC
	
	
```

## zephyr/boards/riscv/fwrisc_test/fwrisc_test_defconfig
```kconfig
CONFIG_BOARD_FWRISC_TEST=y
CONFIG_CONSOLE=y
CONFIG_PRINTK=y
CONFIG_SERIAL=n
CONFIG_UART_CONSOLE=n
CONFIG_RAM_CONSOLE=y
CONFIG_BOOT_BANNER=y

CONFIG_XIP=n
CONFIG_SYS_CLOCK_EXISTS=n
```

## zephyr/soc/riscv/fwrisc_testsoc/Kconfig.defconfig
```kconfig
if SOC_FWRISC_TESTSOC


config SOC
	string
	default "fwrisc_testsoc"
	
config SYS_CLOCK_HW_CYCLES_PER_SEC
	int
	default 16000000
	
config RISCV_SOC_INTERRUPT_INIT
	bool
	default y
	
config NUM_IRQS
	int
	default 8
	
endif # SOC_FWRISC_TESTSOC
```

## zephyr/soc/riscv/fwrisc_testsoc/Kconfig.soc
```kconfig
config SOC_FWRISC_TESTSOC
	bool "fwrisc_testsoc SoC"
	select RISCV
	select ATOMIC_OPERATIONS_C
		
```
